## main/Kconfig.projbuild
```kconfig
menu "Grid Board Web"
    config GRID_BOARD_AP_SSID
        string "Wi-Fi AP name"
        default "WIRELESS-GridBoard-Web"
    config GRID_BOARD_AP_PASSWORD
        string "Wi-Fi AP password (8-63 ASCII characters)"
        default "12345678"
        help
            Change this before using the device in a shared environment.
            Do not put a private password into version control.
    config GRID_BOARD_AP_CHANNEL
        int "Wi-Fi AP channel"
        range 1 11
        default 6
endmenu
```

## sdkconfig.defaults
```kconfig
CONFIG_IDF_TARGET="esp32p4"
CONFIG_IDF_EXPERIMENTAL_FEATURES=y
CONFIG_ESP32P4_REV_MIN_301=y
CONFIG_ESPTOOLPY_FLASHMODE_QIO=y
CONFIG_ESPTOOLPY_FLASHSIZE_16MB=y
CONFIG_PARTITION_TABLE_CUSTOM=y
CONFIG_PARTITION_TABLE_CUSTOM_FILENAME="partitions.csv"
CONFIG_PARTITION_TABLE_OFFSET=0x10000
CONFIG_COMPILER_OPTIMIZATION_PERF=y
CONFIG_LIBC_NEWLIB=y
CONFIG_SPIRAM=y
CONFIG_SPIRAM_SPEED_200M=y
CONFIG_SPIRAM_XIP_FROM_PSRAM=y
CONFIG_SPIRAM_USE_MALLOC=y
CONFIG_SPIRAM_MALLOC_ALWAYSINTERNAL=16384
CONFIG_SPIRAM_MALLOC_RESERVE_INTERNAL=65536
CONFIG_CACHE_L2_CACHE_256KB=y
CONFIG_CACHE_L2_CACHE_LINE_128B=y
CONFIG_FREERTOS_HZ=1000
CONFIG_ESP_MAIN_TASK_STACK_SIZE=32768
CONFIG_HTTPD_MAX_REQ_HDR_LEN=2048
CONFIG_HTTPD_MAX_URI_LEN=128
CONFIG_CJSON_NESTING_LIMIT=8
CONFIG_CJSON_CIRCULAR_LIMIT=16
CONFIG_LV_USE_CUSTOM_MALLOC=y
CONFIG_LV_USE_CLIB_STRING=y
CONFIG_LV_USE_CLIB_SPRINTF=y
CONFIG_LV_DRAW_SW_DRAW_UNIT_CNT=1
CONFIG_LV_USE_LOG=y
CONFIG_LV_LOG_LEVEL_WARN=y
# ESP32-C61 radio: exactly the SPI wiring used by ./Grid_Board.
CONFIG_ESP_WIFI_REMOTE_ENABLED=y
CONFIG_ESP_WIFI_REMOTE_LIBRARY_HOSTED=y
CONFIG_SLAVE_IDF_TARGET_ESP32C61=y
CONFIG_ESP_HOSTED_ENABLED=y
CONFIG_ESP_HOSTED_P4_DEV_BOARD_NONE=y
CONFIG_ESP_HOSTED_SPI_HOST_INTERFACE=y
CONFIG_ESP_HOSTED_SPI_HSPI_GPIO_MOSI=14
CONFIG_ESP_HOSTED_SPI_HSPI_GPIO_MISO=15
CONFIG_ESP_HOSTED_SPI_HSPI_GPIO_CLK=18
CONFIG_ESP_HOSTED_SPI_HSPI_GPIO_CS=19
CONFIG_ESP_HOSTED_SPI_GPIO_HANDSHAKE=16
CONFIG_ESP_HOSTED_SPI_GPIO_DATA_READY=17
CONFIG_ESP_HOSTED_SPI_GPIO_RESET_SLAVE=13
CONFIG_ESP_HOSTED_SPI_FREQ_ESP32XX=10
CONFIG_ESP_HOSTED_SPI_RESET_ACTIVE_HIGH=y
CONFIG_ESP_HOSTED_SLAVE_RESET_ON_EVERY_HOST_BOOTUP=y
CONFIG_ESP_HOSTED_DFLT_TASK_STACK=4096
# CONFIG_BT_ENABLED is not set
# CONFIG_ESP_HOSTED_ENABLE_BT_NIMBLE is not set
```
